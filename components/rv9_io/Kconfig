## components/rv9_io/Kconfig
```kconfig
menu "RV-9 devices"

    comment "Always built: the console (/uart0), /f0, /pub0, pipes and /m0. The system uses them itself."

    config RV9_DRV_LCDCON
        bool "/term: the panel as a text console"
        default y

    config RV9_DRV_SVGWIN
        bool "/w0: the panel as a window you write SVG to"
        default y

    config RV9_DRV_TOUCH
        bool "/touch: the panel's touch controller"
        default y

    config RV9_DRV_SDCARD
        bool "/sd0: the microSD card"
        default y

    config RV9_DRV_RAMDISK
        bool "/r0: a volume in RAM"
        default y

    config RV9_DRV_NET
        bool "/n0: WiFi and TCP"
        default y
        help
            The network file manager and the WiFi driver under it. Without
            it there is no SSH, no rshd, no clock from the network and no
            fetch.

    config RV9_DRV_PEER
        bool "/peer: other machines' modules"
        default y
        depends on RV9_DRV_NET
        help
            Another board's modules as files, fetched from its httpd over
            /n0: /peer/<name>/cmd/<command>.mod, peers named in /f0/peers.
            A module path entry of /peer/p4/cmd/ runs what the P4 holds.

    config RV9_PIPE_COUNT
        int "Pipes /pipe holds at once"
        range 4 24
        default 16 if IDF_TARGET_ESP32P4
        default 8
        help
            How many pipes there may be at once, each 256 bytes and a little
            more, allocated at boot. A shell pipeline of n stages takes n-1,
            and each command a peer runs here through execd takes three (its
            input, output and errors), so a board that serves its peers
            wants more than one that only types. A descriptor that names a
            number (opt1) has it instead.

    config RV9_DRV_GPIO
        bool "/gpio: pins"
        default y

    config RV9_DRV_PWM
        bool "/pwm0: pulse-width outputs"
        default y

    config RV9_DRV_ADC
        bool "/adc0: analogue inputs"
        default y

    config RV9_DRV_TSENS
        bool "/tsens: the chip's temperature"
        default y

    config RV9_DRV_I2C
        bool "/i2c0: the two-wire bus, for programs"
        default y
        help
            The device programs open. The bus underneath is built whenever
            anything needs it -- audio, the camera and touch talk to their
            chips over it -- whether or not this is.

    config RV9_DRV_AUDIO
        bool "/au0: microphones and speaker"
        default y

    config RV9_DRV_CAMERA
        bool "/cam0: the camera"
        default y

endmenu
```

## components/rv9_kal/Kconfig
```kconfig
menu "RV-9"

config RV9_KERNEL_NATIVE
    bool "Back the KAL with RV-9's own kernel"
    default n
    help
        Selects which kernel RV-9 runs on.

        Off: the KAL is implemented on FreeRTOS, which is how RV-9 has run
        since phase 0 and remains the reference.

        On: the KAL is implemented on RV-9's own scheduler, and the whole
        system -- processes, I/O, the shell -- is scheduled by it. FreeRTOS
        is still underneath holding one task, which is where RV-9's kernel
        runs; taking the machine outright is phase 7 step 3.

        Both are built from the same sources above the KAL and pass the
        same conformance suite.

config RV9_HEAP_FLOOR
    int "Heap RV-9 will not take (bytes)"
    default 12288
    help
        A reserve that ordinary allocation is refused out of.

        The floor is not for RV-9's benefit. It is for everything RV-9
        cannot ask: WiFi, the PHY, the SPI driver and ESP-IDF's own
        internals allocate straight from the heap and abort when they
        cannot get what they need -- inside a layer RV-9 does not own,
        which on a vehicle means the whole system stopping because a
        display wanted a buffer.

        Allocations that go through the KAL can be told no. So the last
        few kilobytes are simply never offered to them: a request that
        would take free memory below this returns NULL, a process fails
        to start and says so, and the machine stays up.

        Zero disables it, which is how RV-9 behaved before phase 4.

config RV9_SELFTEST
    bool "Build the self-test suites into the firmware"
    default y
    help
        The suites that check the KAL contract, the module manifest, I/O,
        publication, faults, processes, real-time scheduling, memory
        reserves and the card, and the phase demos.

        Built in, they run at a boot that /f0/selftest asks for: "once"
        runs them at the next boot and removes the file, "always" runs
        them at every boot. Otherwise a boot skips them, which on a P4
        is 26 seconds of its 31.

        Off, they are not in the firmware at all. The KAL's own
        self-test is not one of them: every boot runs it, because
        nothing else is worth starting on a floor that is unsound.

config RV9_ARG_MAX
    int "Longest argument a program may be given (characters)"
    range 63 4095
    default 1023 if IDF_TARGET_ESP32P4
    default 255
    help
        What fork will take as a program's argument -- everything after
        its name on the command line -- before it refuses.

        Each process keeps its argument at its own length, so a short one
        costs a short one's bytes on any board, and this is only the
        ceiling: bigger where there is room for it, smaller where there is
        not. 255 is the shell's own line, which is what a person can type;
        the P4's 1023 is for programs that start programs, and is what
        /tts0 takes as one text. An argument over the limit is refused
        with RV9_PE_TOOLONG rather than cut short.

endmenu
```

## components/rv9_ssh/Kconfig
```kconfig
menu "RV-9 SSH"

    config RV9_DRV_SSH
        bool "/ssh0: SSH sessions"
        default y
        depends on RV9_DRV_NET

endmenu
```

## components/rv9_tts/Kconfig
```kconfig
menu "RV-9 voice"

    config RV9_DRV_TTS
        bool "/tts0: text to speech (CMU Flite, 757 KB, P4 only)"
        default y
        help
            Flite and its English voice data. Only the P4 has the external
            memory and the FPU for it; elsewhere the driver alone is built
            and the device does not attach.

endmenu
```
